## config/nrfconnect/chip-module/Kconfig
```kconfig
#
#   Copyright (c) 2021 Project CHIP Authors
#
#   Licensed under the Apache License, Version 2.0 (the "License");
#   you may not use this file except in compliance with the License.
#   You may obtain a copy of the License at
#
#       http://www.apache.org/licenses/LICENSE-2.0
#
#   Unless required by applicable law or agreed to in writing, software
#   distributed under the License is distributed on an "AS IS" BASIS,
#   WITHOUT WARRANTIES OR CONDITIONS OF ANY KIND, either express or implied.
#   See the License for the specific language governing permissions and
#   limitations under the License.
#

rsource "../../zephyr/Kconfig"

if CHIP

# See config/zephyr/Kconfig for full definition
config CHIP_DEVICE_VENDOR_NAME
	default "Nordic Semiconductor ASA"

config CHIP_APP_LOG_LEVEL
	int "Set logging level in application"
	default LOG_DEFAULT_LEVEL
	depends on LOG
	help
	  Sets the logging level in the Matter application.
	  Use this configuration option only within the application.
	  To set the logging level for the Matter stack, use the MATTER_LOG_LEVEL
	  configuration option.

config CHIP_NFC_COMMISSIONING
	bool "Enable NFC commissioning support"
	default n
	imply NFC_T2T_NRFXLIB
	imply NFC_NDEF
	imply NFC_NDEF_MSG
	imply NFC_NDEF_RECORD
	imply NFC_NDEF_URI_REC
	imply NFC_NDEF_URI_MSG
	help
	  Enables the NFC commissioning by sharing the onboarding payload in the NFC tag.

# See config/zephyr/Kconfig for full definition
config CHIP_OTA_REQUESTOR
	bool
	imply DFU_MULTI_IMAGE
	imply DFU_TARGET
	imply BOOTLOADER_MCUBOOT
	imply IMG_MANAGER
	imply STREAM_FLASH
	imply STREAM_FLASH_ERASE

config CHIP_OTA_REQUESTOR_BUFFER_SIZE
	int "OTA Requestor image buffer size"
	default 1024
	depends on CHIP_OTA_REQUESTOR
	help
	  Configures the size of the buffer used by OTA Requestor when downloading and
	  writing a new firmware image to flash.

config CHIP_OTA_REQUESTOR_REBOOT_ON_APPLY
	bool "Auto-reboot when firmware update is applied"
	default y
	depends on CHIP_OTA_REQUESTOR
	imply REBOOT
	help
	  Reboots the device automatically to swap the old and the new
	  firmware images. The reboot happens only when a user consents
	  to apply the firmware update and the update package is downloaded.

# See config/zephyr/Kconfig for full definition
config CHIP_OTA_IMAGE_BUILD
	bool
	default y if CHIP_OTA_REQUESTOR
	depends on SIGN_IMAGES
	select DFU_MULTI_IMAGE_PACKAGE_BUILD

config CHIP_EXAMPLE_DEVICE_INFO_PROVIDER
	bool "Include default device information provider build"
	default y

config CHIP_DEBUG_SYMBOLS
	bool "Generate debug symbols"
	default y
	help
	  Builds the application with debug symbols.

config CHIP_FACTORY_DATA
	bool "Enable factory data support"
	select ZCBOR
	select FPROTECT
	help
	  Enables support for reading the factory data from the flash memory partition.
	  This option requires the factory_data partition in Partition Manager
	  configuration file (pm_static.yml).

config CHIP_FACTORY_DATA_CUSTOM_BACKEND
	bool "Enable factory data custom backend"
	depends on !CHIP_FACTORY_DATA
	help
	  Enables user's custom factory data implementation. This option cannot be used
	  with the CHIP_FACTORY_DATA, which enables the default nRF Connect factory data
	  implementation.

config CHIP_FACTORY_DATA_BUILD
	bool "Enable factory data build"
	default n
	help
	  Enables generation of the factory data during the building.
	  This option requires the factory_data partition in Partition Manager
	  configuration file (pm_static.yml).
	  As a result, a new output file is created (factory_data.hex).

config CHIP_FACTORY_DATA_VERSION
	int
	default 1
	help
	  The factory data version contains the current version of the factory data
	  parameter set, which the user cannot change.
	  After moving to the next version of the factory data set, this option changes the default value.
	  Use this config to validate the version of the factory data set on the device-side
	  with the version of the factory data saved in the flash memory.

if CHIP_FACTORY_DATA_BUILD

# Factory data definitions
config CHIP_FACTORY_DATA_MERGE_WITH_FIRMWARE
	bool "Enable merging the generated factory data with the HEX output build file"
	default y
	help
	  Enables merging the generated factory data with the merged.hex output build file.
	  As a result, the merged.hex build output file, which is used when flashing the firmware
	  using the west tool, includes the factory data as well.

# Select source of the certificates
choice CHIP_FACTORY_DATA_CERT_SOURCE
	prompt "Attestation certificate file source"
	default CHIP_FACTORY_DATA_USE_DEFAULT_CERTS

	config CHIP_FACTORY_DATA_USE_DEFAULT_CERTS
		bool "Use pre-generated development certificates"
		help
			Uses pre-generated certificate files from the credentials/development/attestation/
			directory that match the configured Product ID. This can be used for development
			purpose.
	config CHIP_FACTORY_DATA_CERT_SOURCE_GENERATED
		bool "Auto-generate certificates"
		help
			Generates new certificates instead of using pre-generated ones.
			The certificates are generated on every build.
	config CHIP_FACTORY_DATA_CERT_SOURCE_USER
		bool "Use user-provided certificate files"
		help
			Uses user-provided certificate files.
			The user needs to specify the absolute path to all necessary files.
endchoice

if CHIP_FACTORY_DATA_CERT_SOURCE_USER

config CHIP_FACTORY_DATA_USER_CERTS_DAC_CERT
	string "Path to the DAC certificate *.der-file"
	help
		Provides the absolute path to the DAC certificate file in binary format.
config CHIP_FACTORY_DATA_USER_CERTS_DAC_KEY
	string "Path to the DAC private key *.der-file"
	help
		Provides the absolute path to the DAC keysfile in binary format.
		Both public and private keys must be present (will be extracted automatically).
config CHIP_FACTORY_DATA_USER_CERTS_PAI_CERT
	string "Path to the PAI certificate *.der-file"
	help
		Provides the absolute path pointing to the PAI certificate in binary format.
endif

# Configs for SPAKE2+ generation
config CHIP_FACTORY_DATA_GENERATE_SPAKE2_VERIFIER
	bool "Enable SPAKE2+ verifier generation"
	help
	  Enables the generation of the SPAKE2+ verifier according to
	  the given iteration counter, salt, and passcode.

config CHIP_DEVICE_GENERATE_ROTATING_DEVICE_UID
	bool "Enable generation of a new Rotating device ID unique ID"
	default y
	help
	  Enables the generation of a new Rotating device ID unique ID.

endif #CHIP_FACTORY_DATA_BUILD

# See config/zephyr/Kconfig for full definition
config CHIP_FACTORY_RESET_ERASE_NVS
	bool
	default y if CHIP_FACTORY_DATA || CHIP_FACTORY_DATA_CUSTOM_BACKEND

endif

config CHIP_LOG_SIZE_OPTIMIZATION
	bool "Disable some detailed logs to decrease flash usage"
	help
	  Disables some log levels for specific log modules
	  that provide information that is too detailed to be used in most cases.
	  You can find full configuration enabled by this option
	  in the platform/nrfconnect/CHIPPlatformConfig.h file.
```
